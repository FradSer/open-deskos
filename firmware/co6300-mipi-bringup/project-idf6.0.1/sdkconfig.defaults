## firmware/linux/p4-camera/sdkconfig.defaults
```kconfig
# ESP32-P4 target
CONFIG_IDF_TARGET="esp32p4"

# Chip Revision (ESP32-P4 v1.3 compatibility)
CONFIG_ESP32P4_SELECTS_REV_LESS_V3=y
CONFIG_ESP32P4_REV_MIN_100=y
CONFIG_ESP32P4_REV_MIN_FULL=100
CONFIG_ESP_REV_MIN_FULL=100

# Flash and PSRAM configuration
CONFIG_ESPTOOLPY_FLASHSIZE_16MB=y
CONFIG_PARTITION_TABLE_CUSTOM=y
CONFIG_PARTITION_TABLE_CUSTOM_FILENAME="partitions.csv"
CONFIG_HUMAN_FACE_DETECT_MODEL_IN_FLASH_PARTITION=y
CONFIG_HUMAN_FACE_FEAT_MODEL_IN_FLASH_PARTITION=y
CONFIG_SPIRAM=y
CONFIG_SPIRAM_MODE_HEX=y
CONFIG_SPIRAM_SPEED_200M=y

# FreeRTOS
CONFIG_FREERTOS_HZ=1000

# Camera Interface - MIPI CSI-2 with SC2336
CONFIG_APP_CAMERA_INTERFACE_MIPI_CSI=y
CONFIG_APP_CAMERA_SENSOR_SELECTION_SC2336=y
CONFIG_CAMERA_SC2336=y
CONFIG_CAMERA_SC2336_AUTO_DETECT=y
CONFIG_CAMERA_SC2336_AUTO_DETECT_MIPI_INTERFACE_SENSOR=y
CONFIG_CAMERA_SC2336_MIPI_RAW8_1280x720_30FPS=y

# Default Frame Configuration
CONFIG_APP_CAMERA_FRAME_WIDTH=640
CONFIG_APP_CAMERA_FRAME_HEIGHT=480
CONFIG_APP_CAMERA_BUFFER_COUNT=3
CONFIG_APP_CAMERA_OWNER_CONFIRM_PIN=0
CONFIG_APP_CAMERA_OWNER_CONFIRM_WINDOW_SECONDS=30
CONFIG_APP_CAMERA_OWNER_NAME="Frad"
CONFIG_APP_CAMERA_PIXEL_FORMAT_RGB565=y

# SCCB I2C Pin Configuration for SC2336 on P4
CONFIG_APP_CAMERA_SCCB_I2C_PORT=0
CONFIG_APP_CAMERA_SCCB_I2C_FREQ=100000
CONFIG_APP_CAMERA_MIPI_SCCB_SCL_PIN=8
CONFIG_APP_CAMERA_MIPI_SCCB_SDA_PIN=7
CONFIG_APP_CAMERA_SC2336_MIPI_RESET_PIN=26
CONFIG_APP_CAMERA_SC2336_MIPI_PWDN_PIN=-1

# USB Device Configuration (TinyUSB for CM5 link)
CONFIG_TINYUSB=y
CONFIG_TINYUSB_CDC_ENABLED=y
CONFIG_TINYUSB_CDC_RX_BUFSIZE=512
CONFIG_TINYUSB_CDC_TX_BUFSIZE=512

# Log Level
CONFIG_LOG_DEFAULT_LEVEL_INFO=y
```

## peripherals/esp32-c6-gateway/sdkconfig.defaults
```kconfig
CONFIG_IDF_TARGET="esp32c6"
CONFIG_ESPTOOLPY_FLASHSIZE_4MB=y
CONFIG_ESP_CONSOLE_NONE=y
CONFIG_ESP_CONSOLE_SECONDARY_NONE=y
CONFIG_ESP_WIFI_ESPNOW_MAX_ENCRYPT_NUM=7
CONFIG_BOOTLOADER_LOG_LEVEL_NONE=y
CONFIG_LOG_DEFAULT_LEVEL_NONE=y
```

## peripherals/esp32-p4-camera/main/Kconfig.projbuild
```kconfig
menu "ESP32-P4 SC2336 Camera Configuration"

    config APP_CAMERA_MIPI_SCCB_SDA_PIN
        int "SCCB SDA GPIO Pin"
        default 7

    config APP_CAMERA_MIPI_SCCB_SCL_PIN
        int "SCCB SCL GPIO Pin"
        default 8

    config APP_CAMERA_SC2336_MIPI_RESET_PIN
        int "SC2336 Reset GPIO Pin"
        default 26

    config APP_CAMERA_SC2336_MIPI_PWDN_PIN
        int "SC2336 Power Down GPIO Pin (-1 if unused)"
        default -1

    config APP_CAMERA_SCCB_I2C_PORT
        int "SCCB I2C Port"
        default 0

    config APP_CAMERA_SCCB_I2C_FREQ
        int "SCCB I2C Frequency in Hz"
        default 100000

    config APP_CAMERA_FRAME_WIDTH
        int "UVC Frame Width"
        default 1280

    config APP_CAMERA_FRAME_HEIGHT
        int "UVC Frame Height"
        default 720

    config APP_UVC_JPEG_QUALITY
        int "MJPEG compression quality (1-100)"
        range 1 100
        default 80

    config APP_USB_MICROPHONE
        bool "Expose the board microphone as a USB Audio Class input"
        default y

    config APP_AUDIO_I2S_PORT
        int "ES8311 I2S port"
        default 0
        depends on APP_USB_MICROPHONE

    config APP_AUDIO_I2S_MCLK_PIN
        int "ES8311 I2S MCLK GPIO"
        default 13
        depends on APP_USB_MICROPHONE

    config APP_AUDIO_I2S_BCLK_PIN
        int "ES8311 I2S BCLK GPIO"
        default 12
        depends on APP_USB_MICROPHONE

    config APP_AUDIO_I2S_WS_PIN
        int "ES8311 I2S WS/LRCLK GPIO"
        default 10
        depends on APP_USB_MICROPHONE

    config APP_AUDIO_I2S_DIN_PIN
        int "ES8311 ASDOUT to P4 I2S DIN GPIO"
        default 11
        depends on APP_USB_MICROPHONE

    config APP_AUDIO_INPUT_GAIN_DB
        int "ES8311 microphone input gain in dB"
        range 0 42
        default 30
        depends on APP_USB_MICROPHONE

endmenu
```

## peripherals/esp32-p4-camera/sdkconfig.defaults
```kconfig
# ESP32-P4 target
CONFIG_IDF_TARGET="esp32p4"

# Chip Revision (ESP32-P4 v1.3 compatibility)
CONFIG_ESP32P4_SELECTS_REV_LESS_V3=y
CONFIG_ESP32P4_REV_MIN_100=y
CONFIG_ESP32P4_REV_MIN_FULL=100
CONFIG_ESP_REV_MIN_FULL=100

# Flash and PSRAM configuration
CONFIG_ESPTOOLPY_FLASHSIZE_16MB=y
CONFIG_PARTITION_TABLE_CUSTOM=y
CONFIG_PARTITION_TABLE_CUSTOM_FILENAME="partitions.csv"
CONFIG_SPIRAM=y
CONFIG_SPIRAM_MODE_HEX=y
CONFIG_SPIRAM_SPEED_200M=y

# FreeRTOS
CONFIG_FREERTOS_HZ=1000

# Camera Interface - MIPI CSI-2 with SC2336
CONFIG_CAMERA_SC2336=y
CONFIG_CAMERA_SC2336_AUTO_DETECT=y
CONFIG_CAMERA_SC2336_AUTO_DETECT_MIPI_INTERFACE_SENSOR=y
CONFIG_CAMERA_SC2336_MIPI_RAW8_1280x720_30FPS=y

# Hardware JPEG encoder for the UVC MJPEG stream
CONFIG_ESP_VIDEO_ENABLE_HW_JPEG_VIDEO_DEVICE=y

# Default UVC Frame Configuration
CONFIG_APP_CAMERA_FRAME_WIDTH=1280
CONFIG_APP_CAMERA_FRAME_HEIGHT=720
CONFIG_APP_UVC_JPEG_QUALITY=80

# SCCB I2C Pin Configuration for SC2336 on P4
CONFIG_APP_CAMERA_SCCB_I2C_PORT=0
CONFIG_APP_CAMERA_SCCB_I2C_FREQ=100000
CONFIG_APP_CAMERA_MIPI_SCCB_SCL_PIN=8
CONFIG_APP_CAMERA_MIPI_SCCB_SDA_PIN=7
CONFIG_APP_CAMERA_SC2336_MIPI_RESET_PIN=26
CONFIG_APP_CAMERA_SC2336_MIPI_PWDN_PIN=-1

# USB Device Configuration (UVC camera + UAC microphone composite)
CONFIG_TINYUSB=y
CONFIG_USB_DEVICE_UAC_AS_PART=y
CONFIG_UAC_SPEAKER_CHANNEL_NUM=0
CONFIG_UAC_MIC_CHANNEL_NUM=1
CONFIG_UAC_SAMPLE_RATE=16000
CONFIG_UAC_BIT_RESOLUTION_16=y
CONFIG_CODEC_ES8311_SUPPORT=y
CONFIG_APP_USB_MICROPHONE=y

# OSPTEK ESP32-P4C6 module baseboard V1.3 audio wiring.
CONFIG_APP_AUDIO_I2S_PORT=0
CONFIG_APP_AUDIO_I2S_MCLK_PIN=13
CONFIG_APP_AUDIO_I2S_BCLK_PIN=12
CONFIG_APP_AUDIO_I2S_WS_PIN=10
CONFIG_APP_AUDIO_I2S_DIN_PIN=11
CONFIG_APP_AUDIO_INPUT_GAIN_DB=30

# Log Level
CONFIG_LOG_DEFAULT_LEVEL_INFO=y
```

## peripherals/esp32-s3-remote/sdkconfig.defaults
```kconfig
CONFIG_IDF_TARGET="esp32s3"
CONFIG_ESP_DEFAULT_CPU_FREQ_MHZ_240=y
CONFIG_ESPTOOLPY_FLASHMODE_DIO=y
CONFIG_ESPTOOLPY_FLASHFREQ_80M=y
CONFIG_ESPTOOLPY_FLASHSIZE_16MB=y
CONFIG_PARTITION_TABLE_SINGLE_APP=y
CONFIG_PARTITION_TABLE_SINGLE_APP_LARGE=y
CONFIG_SPIRAM=y
CONFIG_SPIRAM_MODE_OCT=y
CONFIG_SPIRAM_SPEED_80M=y

# The board exposes USB-Serial/JTAG only; it carries the Remote protocol.
CONFIG_ESP_CONSOLE_USB_SERIAL_JTAG=y
# CONFIG_ESP_CONSOLE_UART_DEFAULT is not set
# CONFIG_ESP_CONSOLE_SECONDARY_USB_SERIAL_JTAG is not set
```
